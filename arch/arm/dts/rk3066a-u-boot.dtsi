// SPDX-License-Identifier: GPL-2.0+

#include "rockchip-u-boot.dtsi"
#include "rk3xxx-u-boot.dtsi"

/ {
	aliases {
		gpio0 = &gpio0;
		gpio1 = &gpio1;
		gpio2 = &gpio2;
		gpio3 = &gpio3;
		gpio4 = &gpio4;
		gpio6 = &gpio6;
	};
};
