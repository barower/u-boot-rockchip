// SPDX-License-Identifier: GPL-2.0+
/*
 * (C) Copyright 2021 Rockchip Electronics Co., Ltd
 */

#include "rk3588-u-boot.dtsi"

/ {
	chosen {
		stdout-path = &uart2;
		u-boot,spl-boot-order = "same-as-spl", &sdmmc, &sdhci;
	};
};

&uart2 {
	clock-frequency = <24000000>;
	u-boot,dm-spl;
	status = "okay";
};
